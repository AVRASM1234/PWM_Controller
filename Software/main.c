/*
 * PWM_Controller.c
 *
 * Created: 18.01.2018 22:08:13
 * Author : AVRASM1234
 */ 
#define F_CPU			9600000UL

#include <avr/io.h>
#include <avr/interrupt.h>
#include <util/delay.h>
#include <avr/pgmspace.h>

#define  BUTTON			(PINB & (1<<PORTB3))

unsigned char __BUT_PrevState = 0;
unsigned char __PWM_Enabled = 0;

// Табличка, с помощью которой будем регулировать яркость не линейно, а по экспоненте,
// чтобы яркость менялась зрительно-линейно...
const unsigned char PerToFill[256] PROGMEM = 
{
	0x00, 0x00, 0x00, 0x00, 0x00, 0x01, 0x01, 0x01, 
	0x01, 0x01, 0x01, 0x01, 0x01, 0x01, 0x01, 0x01, 
	0x01, 0x01, 0x01, 0x02, 0x02, 0x02, 0x02, 0x02, 
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	0xDB, 0xE0, 0xE5, 0xEA, 0xEF, 0xF4, 0xF9, 0xFF
};

int main(void)
{
    DDRB = 0b00000111;
    PORTB = 0;
	
	// Настройка таймера
	TCCR0A = 0b10100001;
	TCCR0B = 0b00000001;
	TCNT0 = 0;
	TIMSK0 = 0;
	
	OCR0A = 0;
	OCR0B = 0;
	
	// Настройка АЦП
	ADMUX = 0b00100010;
	ADCSRA = 0b10001111;
	
	sei();
    while (1) 
    {
		// Проверяем нажатие кнопки включения
		if (BUTTON == 0)
		{
			// Если кнопка нажата - запоминаем это
			__BUT_PrevState = 1;
		}
		else
		{
			// Если кнопка отпущена...
			if (__BUT_PrevState == 1)
			{
				// ...но до этого нажата - инвертируем состояние нашего ШИМ-контроллера и запоминаем состояние кнопки
				__BUT_PrevState = 0;
				__PWM_Enabled ^= (1<<0);
				PORTB ^= (1<<PORTB2);
			}
		}
		
		// Если контроллер включен
		if (__PWM_Enabled)
			// Запускаем преобразование АЦП
			ADCSRA |= (1<<ADSC);
		else
			// Иначе тупо гасим свет
			OCR0A = 0;
		// Делаем выдержку в 50 мс
		_delay_ms(50);	
    }
}

ISR(ADC_vect)
{
	// Когда закончим АЦ преобразование - пхаем в регистр ШИМ преобразованное значение яркости свечения в заполненость ШИМ (сам не понял что написал...)
	OCR0A = pgm_read_byte(&PerToFill[ADCH]);
}
